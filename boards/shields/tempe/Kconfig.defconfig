## boards/shields/tempe/Kconfig.defconfig
```kconfig
if SHIELD_TEMPE_LEFT

config ZMK_KEYBOARD_NAME
    default "tempe"

config ZMK_SPLIT_ROLE_CENTRAL
    default y

endif

if SHIELD_TEMPE_LEFT || SHIELD_TEMPE_RIGHT

config ZMK_SPLIT
    default y

endif
```

## boards/shields/tempe/Kconfig.shield
```kconfig
# Copyright (c) 2020 Pete Johanson
# SPDX-License-Identifier: MIT

config SHIELD_TEMPE_LEFT
    def_bool $(shields_list_contains,tempe_left)

config SHIELD_TEMPE_RIGHT
    def_bool $(shields_list_contains,tempe_right)
```

## boards/shields/temper/Kconfig.defconfig
```kconfig
if SHIELD_TEMPER_LEFT

config ZMK_KEYBOARD_NAME
    default "temper"

config ZMK_SPLIT_ROLE_CENTRAL
    default y

endif

if SHIELD_TEMPER_LEFT || SHIELD_TEMPER_RIGHT

config ZMK_SPLIT
    default y

endif

config ZMK_DISPLAY

if ZMK_DISPLAY

config SSD1306
    default y

config I2C
    default y

endif # ZMK_DISPLAY
```
